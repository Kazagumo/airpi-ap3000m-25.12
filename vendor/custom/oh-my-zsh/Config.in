## vendor/custom/oh-my-zsh/Config.in
```kconfig
menu "Plugins"

config ZSH_AUTOSUGGESTIONS
	bool
	default y
	prompt "Enable zsh auto suggestion plugin"

config ZSH_SYNTAX_HIGHLIGHTING
	bool
	default y
	prompt "Enable zsh syntax highlighting plugin"

config ZSH_COMPLETIONS
	bool
	default y
	prompt "Enable zsh auto complete plugin"

endmenu
```
